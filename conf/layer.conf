## conf/layer.conf
```bitbake
# We have a conf and classes directory, append to BBPATH
BBPATH .= ":${LAYERDIR}"

BBFILES += "\
    ${LAYERDIR}/recipes*/*/*.bb \
    ${LAYERDIR}/recipes*/*/*.bbappend \
"

BBFILE_COLLECTIONS += "powervr-layer"
BBFILE_PATTERN_powervr-layer := "^${LAYERDIR}/"
BBFILE_PRIORITY_powervr-layer = "12"

LAYERSERIES_COMPAT_powervr-layer = "scarthgap whinlatter wrynose blacksail"

LAYERRECOMMENDS_powervr-layer = " clang-layer"

BBFILES_DYNAMIC += " \
    clang-layer:${LAYERDIR}/dynamic-layers/clang-layer/*/*/*.bb \
    clang-layer:${LAYERDIR}/dynamic-layers/clang-layer/*/*/*/*.bb \
    clang-layer:${LAYERDIR}/dynamic-layers/clang-layer/*/*/*.bbappend \
"
```
